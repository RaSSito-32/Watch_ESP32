## Watch_ESP32/components/mqtt_data_send/Kconfig.projbuild
```kconfig
menu "MQTT config"
    
    config BROKER_URL
        string "Broker URL"
        default "mqtt://demo.thingsboard.io"
        help
            URL del dispositivo para el thingsboard.

    config TOKEN
        string "Token"
        default "08mcKYiLTf9EdKe766XE"
        help 
            Token del device del thingsboard.
endmenu
```

## Watch_ESP32/components/ssd1306/Kconfig.projbuild
```kconfig
menu "SSD1306 Configuration"

	config GPIO_RANGE_MAX
		int
		default 33 if IDF_TARGET_ESP32
		default 46 if IDF_TARGET_ESP32S2
		default 48 if IDF_TARGET_ESP32S3
		default 18 if IDF_TARGET_ESP32C2
		default 19 if IDF_TARGET_ESP32C3
		default 30 if IDF_TARGET_ESP32C6
		default 27 if IDF_TARGET_ESP32H2

	choice INTERFACE
		prompt "Interface"
		default I2C_INTERFACE
		help
			Seleccionar interfaz de comunicacion
		config I2C_INTERFACE
			bool "I2C Interface"
			help
				I2C Interface.
		config SPI_INTERFACE
			bool "SPI Interface"
			help
				SPI Interface.
	endchoice

	choice PANEL
		prompt "Panel Type"
		default SSD1306_128x64
		help
			Seleccionar tipo de panel.
		config SSD1306_128x32
			bool "128x32 Panel"
			help
				Panel es 128x32.
		config SSD1306_128x64
			bool "128x64 Panel"
			help
				Panel es 128x64.
	endchoice

	config OFFSETX
		int "GRAM X OFFSET"
		range 0 99
		default 0
		help
			When your TFT have offset(X), set it.

	config FLIP
		bool "Flip upside down"
		default false
		help
			Flip upside down.

	config SCL_GPIO
		depends on I2C_INTERFACE
		int "SCL GPIO number"
		range 0 GPIO_RANGE_MAX
		default 22 if IDF_TARGET_ESP32
		default  2 if IDF_TARGET_ESP32S2 || IDF_TARGET_ESP32S3
		default  2 if IDF_TARGET_ESP32H2
		default  6 # C3 and others
		help
			Seleccionar GPIO para la linea SCL, no usar el GPIO 35-39 ya que solo son pines solo input.

	config SDA_GPIO
		depends on I2C_INTERFACE
		int "SDA GPIO number"
		range 0 GPIO_RANGE_MAX
		default 21 if IDF_TARGET_ESP32
		default  1 if IDF_TARGET_ESP32S2 || IDF_TARGET_ESP32S3
		default  1 if IDF_TARGET_ESP32H2
		default  5 # C3 and others
		help
			Seleccionar GPIO para la linea SDA, no usar el GPIO 35-39 ya que solo son pines solo input.

	config MOSI_GPIO
		depends on SPI_INTERFACE
		int "MOSI GPIO number"
		range 0 GPIO_RANGE_MAX
		default 23 if IDF_TARGET_ESP32
		default 35 if IDF_TARGET_ESP32S2 || IDF_TARGET_ESP32S3
		default  1 # C3 and others
		help
			Seleccionar GPIO para el SPI MOSI, no usar el GPIO 35-39 y 46 ya que solo son pines solo input.

	config SCLK_GPIO
		depends on SPI_INTERFACE
		int "SCLK GPIO number"
		range 0 GPIO_RANGE_MAX
		default 18 if IDF_TARGET_ESP32
		default 36 if IDF_TARGET_ESP32S2 || IDF_TARGET_ESP32S3
		default  2 # C3 and others
		help
			Seleccionar GPIO para el CLK, no usar el GPIO 35-39 y 46 ya que solo son pines solo input.

	config CS_GPIO
		depends on SPI_INTERFACE
		int "CS GPIO number"
		range 0 GPIO_RANGE_MAX
		default  5 if IDF_TARGET_ESP32
		default 34 if IDF_TARGET_ESP32S2 || IDF_TARGET_ESP32S3
		default 10 # C3 and others
		help
			Seleccionar GPIO para el Chip select del SPI, no usar el GPIO 35-39 ya que solo son pines solo input.

	config DC_GPIO
		depends on SPI_INTERFACE
		int "DC GPIO number"
		range 0 GPIO_RANGE_MAX
		default  4 if IDF_TARGET_ESP32
		default 37 if IDF_TARGET_ESP32S2 || IDF_TARGET_ESP32S3
		default  3 # C3 and others
		help
			Seleccionar GPIO para el DC del SPI, no usar el GPIO 35-39 ya que solo son pines solo input.

	config RESET_GPIO
		int "RESET GPIO number"
		range -1 GPIO_RANGE_MAX
		default 15 if IDF_TARGET_ESP32
		default 38 if IDF_TARGET_ESP32S2 || IDF_TARGET_ESP32S3
		default  4 # C3 and others
		help
			Seleccionar GPIO para el RESET, no usar el GPIO 35-39 ya que solo son pines solo input.

	choice I2C_PORT
		depends on I2C_INTERFACE
		prompt "I2C port that controls this bus"
		default I2C_PORT_0
		help
			Seleccionar puerto I2C.
		config I2C_PORT_0
			bool "I2C_PORT_0"
			help
				Use I2C_PORT_0.
		config I2C_PORT_1
			depends on IDF_TARGET_ARCH_XTENSA
			bool "I2C_PORT_1"
			help
				Use I2C_PORT_1.
	endchoice

	config LEGACY_DRIVER
		depends on I2C_INTERFACE
		bool "Force legacy i2c driver"
		default false
		help
			Debe ser habilitada en el caso que se utilice un driver antiguo de I2C.

	choice SPI_HOST
		depends on SPI_INTERFACE
		prompt "SPI peripheral that controls this bus"
		default SPI2_HOST
		help
			Selecciona el periférico de control del SPI
		config SPI2_HOST
			bool "SPI2_HOST"
			help
				Use SPI2_HOST. This is also called HSPI_HOST.
		config SPI3_HOST
			depends on IDF_TARGET_ARCH_XTENSA
			bool "SPI3_HOST"
			help
				USE SPI3_HOST. This is also called VSPI_HOST
	endchoice

endmenu
```

## Watch_ESP32/components/wifi/Kconfig.projbuild
```kconfig
menu "AP config"
    
    config SSID
        string "SSID"
        default "espc4c0"
        help
            Configurar el SSID del Access-Point

    config PSWD
        string "PSWD"
        default "12345678"
        help 
            Configurar la password del Access-Point
    
    config CHANNEL
        int "CHANNEL"
        range 0 1
        default 0
        help
            Configurar el canal del Access-Point
    
    config MAX_CONECTION
        int "MAX_CONECTION"
        range 0 4
        default 4
        help
            Configurar el numero de conexiones simulataneas al Access-Point
            
endmenu
```
